## firmware/main/Kconfig.projbuild
```kconfig
menu "MicroHydros Configuration"

    config WIFI_SSID
        string "WiFi SSID"
        default "your_ssid"

    config WIFI_PASSWORD
        string "WiFi Password"
        default "your_password"

    config MQTT_BROKER_URL
        string "MQTT Broker URL"
        default "mqtt://95.216.208.235:1883"

    config DEVICE_ID
        string "Device ID"
        default "esp32s3-01"

    config ONEWIRE_GPIO
        int "1-Wire GPIO pin"
        default 4

    config I2C_SDA_GPIO
        int "I2C SDA GPIO pin"
        default 8

    config I2C_SCL_GPIO
        int "I2C SCL GPIO pin"
        default 9

    config TELEMETRY_INTERVAL_SEC
        int "Telemetry publish interval (seconds)"
        default 30

endmenu
```
